qcom,ocl-unknown-batterydata {
	qcom, = <24>;
	/* #2878624_HTC_B2Q3F100lishen_2600mAh_averaged_MasterSlave_Apr11th2017*/
	qcom,max-voltage-uv = <4400000>;
	qcom,nom-batt-capacity-mah = <2600>;
	qcom,batt-id-kohm = <22>;
	qcom,battery-beta = <4360>;
	qcom,battery-type = "ocl_unknown";
	qcom,checksum = <0x9AD6>;
	qcom,gui-version = "PMI8998GUI - 2.0.0.55";

	qcom,fastchg-current-ma = <2600>;
	qcom,fg-cc-cv-threshold-mv = <4400>;
	qcom,fcc-mah = <2600>;

	htc,batt_id = <255>;
	htc,id_raw_min = <63001>;
	htc,id_raw_max = <450000>;

	qcom,fg-profile-data = [
		 66 1F B3 05
		 78 0A 8B FC
		 73 1D 57 07
		 32 12 45 14
		 38 18 1C 23
		 7F 45 BD 52
		 56 00 00 00
		 0F 00 00 00
		 00 00 16 C4
		 78 C5 41 C3
		 1B 00 08 00
		 55 E2 B4 E4
		 B1 FD 84 00
		 D5 00 3E 12
		 2D 05 19 3B
		 16 06 09 20
		 27 00 14 00
		 EA 1F 44 05
		 CC 0A F4 05
		 51 1D A0 00
		 C3 03 AC 15
		 80 19 9F 22
		 BE 45 9E 52
		 56 00 00 00
		 0E 00 00 00
		 00 00 FB 07
		 19 C3 B3 C4
		 17 00 00 00
		 23 EA B4 E4
		 DF FD EC EB
		 C6 C5 60 0A
		 06 01 B2 12
		 99 33 CC FF
		 07 10 00 00
		 9B 0A 66 46
		 17 00 40 00
		 1E 02 0A FA
		 FF 00 00 00
		 00 00 00 00
		 00 00 00 00
		 00 00 00 00
		 00 00 00 00
		 00 00 00 00
		 00 00 00 00
		 00 00 00 00
		 00 00 00 00
		 00 00 00 00
		 00 00 00 00
		 00 00 00 00
		 00 00 00 00
		 00 00 00 00
		 00 00 00 00
		 00 00 00 00
		 00 00 00 00
		 00 00 00 00
		 00 00 00 00
	];
};
