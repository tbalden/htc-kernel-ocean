## drivers/htc_ril/Kconfig
```kconfig
config HTC_GARBAGE_FILTER
	tristate "HTC_GARBAGE_FILTER"
	default n
	depends on MSM_SMD
	---help---
	  HTC Garbage Filter of TCP

config HTC_DEBUG_RIL_PCN0010_HTC_DUMP_IPCROUTER_LOG
    tristate "HTC_DEBUG_RIL_PCN0010_HTC_DUMP_IPCROUTER_LOG"
    default y
    depends on IPC_ROUTER
    ---help---
      Dump IPC router modem log message

config HTC_DEBUG_RIL_PCN0011_HTC_DUMP_IPC_UNREAD_PACKAGE
    tristate "HTC_DEBUG_RIL_PCN0011_HTC_DUMP_IPC_UNREAD_PACKAGE"
    default y
    depends on IPC_ROUTER
    ---help---
      Dump IPC router unread package
```

## drivers/misc/fpr_FingerprintCard/Kconfig
```kconfig
#
# FingerprintCard fingerprint driver
#
menu "FingerprintCard fingerprint driver"
config FPR_FPC
       default n
       tristate "FPC_BTP fingerprint sensor support"
       depends on SPI_MASTER

config FPC_HTC_DISABLE_CHARGING
       tristate "HTC FPC disable charging while capturing image during enroll/verify"
       depends on FPR_FPC
       default n

config FPC_HTC_ENABLE_DBG
       tristate "HTC FPC enable dbg log"
       depends on FPR_FPC
       default y

config FPF_TS_PRESSURE
       default y
       tristate "Touchscreen input driver uses ABS_MT_PRESSURE"

config FPF_KAD
       default y
       tristate "kernel ambient display enabled"

endmenu
```
